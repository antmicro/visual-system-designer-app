## prj.conf
```kconfig
CONFIG_PRINTK=y
CONFIG_SHELL=y
CONFIG_INIT_STACKS=y
CONFIG_THREAD_STACK_INFO=y
CONFIG_KERNEL_SHELL=y
CONFIG_LED=y
CONFIG_LED_SHELL=y
CONFIG_THREAD_MONITOR=y
CONFIG_BOOT_BANNER=y
CONFIG_THREAD_NAME=y
CONFIG_DEVICE_SHELL=y
CONFIG_POSIX_CLOCK=y
CONFIG_DATE_SHELL=y
CONFIG_THREAD_RUNTIME_STATS=y
CONFIG_THREAD_RUNTIME_STATS_USE_TIMING_FUNCTIONS=y
CONFIG_STATS=y
CONFIG_STATS_SHELL=y
CONFIG_SHELL_BACKEND_SERIAL_API_POLLING=y
```

## src/main.c
```c
/*
 * Copyright (c) 2023 Antmicro <www.antmicro.com>
 * SPDX-License-Identifier: Apache-2.0
 */
#include <stdio.h>

int main(void)
{
	printf("Hello on %s", CONFIG_BOARD);
	return 0;
}
```
